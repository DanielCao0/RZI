## CMakeLists.txt
```
# SPDX-FileCopyrightText: Copyright (c) 2026 RAKwireless
# SPDX-License-Identifier: Apache-2.0

cmake_minimum_required(VERSION 3.20.0)

find_package(Zephyr REQUIRED HINTS $ENV{ZEPHYR_BASE})
project(rzi_at)

target_sources(app PRIVATE src/main.c)
```

## sample.yaml
```
# SPDX-FileCopyrightText: Copyright (c) 2026 RAKwireless
# SPDX-License-Identifier: Apache-2.0
sample:
  name: RZI AT
  description: >
    RAK RUI3-compatible AT command interface over USB CDC UART, with the
    LoRaWAN, P2P and radio-test command packages
tests:
  sample.rzi.at:
    sysbuild: true
    build_only: true
    tags:
      - rzi
      - lorawan
      - lora
      - at
    platform_allow:
      - rak4631/nrf52840/rzi
      - rak3172/stm32wle5xx/rzi
      - rak3372_f/stm32wle5xx
      - rak3362/nrf54l15/cpuapp
    integration_platforms:
      - rak4631/nrf52840/rzi
      - rak3172/stm32wle5xx/rzi
      - rak3372_f/stm32wle5xx
      - rak3362/nrf54l15/cpuapp
```

## prj.conf
```kconfig
# SPDX-FileCopyrightText: Copyright (c) 2026 RAKwireless
# SPDX-License-Identifier: Apache-2.0
CONFIG_GPIO=y
CONFIG_SPI=y
CONFIG_FLASH=y
CONFIG_PM_DEVICE=y
CONFIG_TEST_RANDOM_GENERATOR=y
CONFIG_HEAP_MEM_POOL_SIZE=8192
# smtc_modem_init runs on the AT thread when AT+NWM selects P2P.
CONFIG_RZI_AT_THREAD_STACK_SIZE=4096

# The AT service owns the serial port: keep logs and console off it.
CONFIG_LOG=n
CONFIG_CONSOLE=n
CONFIG_UART_CONSOLE=n

# USB CDC ACM serial port used for AT commands.
CONFIG_SERIAL=y
CONFIG_UART_LINE_CTRL=y
CONFIG_USB_DEVICE_STACK_NEXT=y
CONFIG_CDC_ACM_SERIAL_INITIALIZE_AT_BOOT=y

# Zephyr LoRaWAN subsystems stay disabled; RZI uses the USP/LBM backend.
CONFIG_LORA=n
CONFIG_LORAWAN=n

CONFIG_RZI=y
CONFIG_RZI_LORAWAN=y
CONFIG_RZI_AT=y
CONFIG_RZI_AT_COMMAND_LORAWAN=y
CONFIG_RZI_LORA=y
CONFIG_RZI_AT_COMMAND_LORA=y
CONFIG_RZI_AT_ADAPTER_UART=y
CONFIG_RZI_AT_NVM=y
# Settings backend choice (cannot be selected by the module).
CONFIG_SETTINGS_NVS=y

CONFIG_RZI_MCUBOOT=y
CONFIG_STREAM_FLASH=y
CONFIG_IMG_MANAGER=y
CONFIG_LORA_BASICS_MODEM_DRIVERS_EVENT_TRIGGER_NO_THREAD=y

# AT+CLASS=B/C, the class B commands, and the multicast commands need these.
CONFIG_LORA_BASICS_MODEM_CLASS_B=y
CONFIG_LORA_BASICS_MODEM_CLASS_C=y
CONFIG_LORA_BASICS_MODEM_MULTICAST=y
```

## boards/rak3172_stm32wle5xx_rzi.conf
```kconfig
# SPDX-FileCopyrightText: Copyright (c) 2026 RAKwireless
# SPDX-License-Identifier: Apache-2.0

# AT commands use the physical LPUART1, not a USB CDC device.
CONFIG_USB_DEVICE_STACK_NEXT=n
CONFIG_CDC_ACM_SERIAL_INITIALIZE_AT_BOOT=n
CONFIG_UART_LINE_CTRL=n
```

## boards/rzi_rak3362_nrf54l15_cpuapp.conf
```kconfig
# SPDX-FileCopyrightText: Copyright (c) 2026 RAKwireless
# SPDX-License-Identifier: Apache-2.0
# nRF54L15 has no USB device controller; the AT port is uart20.

CONFIG_USB_DEVICE_STACK_NEXT=n
CONFIG_CDC_ACM_SERIAL_INITIALIZE_AT_BOOT=n
```

## boards/rzi_rak3372_f_stm32wle5xx.conf
```kconfig
# SPDX-FileCopyrightText: Copyright (c) 2026 RAKwireless
# SPDX-License-Identifier: Apache-2.0
# STM32WLE5 has no USB device controller; the AT port is lpuart1 (PA2/PA3).
# The 192 KiB image-0 slot cannot hold the USP stack plus the USB device stack.

CONFIG_USB_DEVICE_STACK_NEXT=n
CONFIG_CDC_ACM_SERIAL_INITIALIZE_AT_BOOT=n
CONFIG_UART_LINE_CTRL=n
# LTO needs local ISR declarations when the vector table is generated.
CONFIG_ISR_TABLES_LOCAL_DECLARATION=y
CONFIG_LTO=y
# Debug prints share LPUART1 with AT. The log subsystem does not fit in the 192 KiB slot.
CONFIG_CONSOLE=y
CONFIG_UART_CONSOLE=y
CONFIG_PRINTK=y
CONFIG_BOOT_BANNER=n
# The 8 KiB settings area may still hold a previous modem image.
# Erase it when every sector looks closed so the first DevEUI write can format NVS.
CONFIG_NVS_INIT_BAD_MEMORY_REGION=y
```

## boards/rzi_rak3372_stm32wle5xx.conf
```kconfig
# SPDX-FileCopyrightText: Copyright (c) 2026 RAKwireless
# SPDX-License-Identifier: Apache-2.0
# STM32WLE5 has no USB device controller; the AT port is lpuart1 (PA2/PA3).

CONFIG_USB_DEVICE_STACK_NEXT=n
CONFIG_CDC_ACM_SERIAL_INITIALIZE_AT_BOOT=n
```

## boards/rak3372_f_stm32wle5xx.overlay
```dts
/*
 * SPDX-FileCopyrightText: Copyright (c) 2026 RAKwireless
 * SPDX-License-Identifier: Apache-2.0
 */

/*
 * Debug logs use the RAK19007 USB-UART (LPUART1, PA2/PA3). This overlay
 * applies only to the AT sample.
 */
/ {
	chosen {
		zephyr,console = &lpuart1;
		zephyr,shell-uart = &lpuart1;
	};
};
```

## boards/rzi_rak3372_f_stm32wle5xx.overlay
```dts
/*
 * SPDX-FileCopyrightText: Copyright (c) 2026 RAKwireless
 * SPDX-License-Identifier: Apache-2.0
 */

/*
 * Debug logs use the RAK19007 USB-UART (USART2). The WisBlock header
 * console stays USART1 in the board devicetree; this overlay only
 * applies to the AT sample.
 */
/ {
	chosen {
		zephyr,console = &usart2;
		zephyr,shell-uart = &usart2;
	};
};
```

## src/main.c
```c
/* SPDX-FileCopyrightText: Copyright (c) 2026 RAKwireless */
/* SPDX-License-Identifier: Apache-2.0 */

#include <errno.h>
#include <zephyr/device.h>
#include <zephyr/devicetree.h>
#include <zephyr/drivers/uart.h>
#include <zephyr/kernel.h>
#include <rzi/at/at.h>
#include <rzi/at/uart.h>
#include <rzi/err.h>
#include <rzi/version.h>

#define AT_UART_NODE DT_ALIAS(rzi_at_uart)

#if !DT_NODE_EXISTS(AT_UART_NODE)
#error "The board overlay must define the rzi-at-uart alias"
#endif

static const struct device *const at_uart = DEVICE_DT_GET(AT_UART_NODE);

int main(void)
{
	if (!device_is_ready(at_uart)) {
		return -RZI_ERR_NO_DEVICE;
	}

	/* Give a USB CDC host time to open the port before the service
	 * starts; on a plain UART this returns immediately.
	 */
	if (DT_NODE_HAS_COMPAT(AT_UART_NODE, zephyr_cdc_acm_uart)) {
		uint32_t dtr = 0;

		for (int i = 0; i < 100 && dtr == 0; i++) {
			(void)uart_line_ctrl_get(at_uart, UART_LINE_CTRL_DTR, &dtr);
			k_msleep(100);
		}
	}

	/* The AT service owns the UART from here on. */
	int rc = rzi_at_uart_start(at_uart);

	if (rc != 0) {
		return rc;
	}

	/* One unsolicited line in the +EVT form that RUI3 hosts already skip;
	 * the value matches AT+VER.
	 */
	return rzi_at_publish_event("BOOT:RZI_%s_%s", rzi_version_get_string(), CONFIG_BOARD);
}
```
