/* SPDX-License-Identifier: Apache-2.0 */
/*
 * rak3362 has no USB device. The base board USB-C port reaches uart20
 * through a USB-UART converter, so the AT adapter uses that UART.
 * USP enables CONFIG_SEMTECH_SX126X only for semtech,sx1262-new.
 */

#include <zephyr/dt-bindings/usp/sx126x.h>

/ {
	aliases {
		rzi-at-uart = &uart20;
	};
};

&lora {
	compatible = "semtech,sx1262-new";
	/delete-property/ dio2-tx-enable;
	/delete-property/ dio3-tcxo-voltage;
	/delete-property/ tcxo-power-startup-delay-ms;

	dio2-as-rf-switch;
	dio3-as-tcxo-control;
	tcxo-voltage = <SX126X_TCXO_SUPPLY_1_8V>;
	tcxo-wakeup-time = <5>;
	reg-mode = <SX126X_REG_MODE_DCDC>;
};
