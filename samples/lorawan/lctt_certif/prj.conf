## CMakeLists.txt
```
# SPDX-FileCopyrightText: Copyright (c) 2026 RAKwireless
# SPDX-License-Identifier: Apache-2.0

cmake_minimum_required(VERSION 3.20.0)

find_package(Zephyr REQUIRED HINTS $ENV{ZEPHYR_BASE})
project(rzi_lorawan_lctt_certif)

target_sources(app PRIVATE src/main.c)
```

## Kconfig
```
# SPDX-FileCopyrightText: Copyright (c) 2026 RAKwireless
# SPDX-License-Identifier: Apache-2.0

mainmenu "RZI LoRaWAN certification sample"

config APP_LCTT_CERTIFICATION
	bool "Enable LoRaWAN certification mode"
	default y
	help
	  The stack keeps this mode across resets. Build with this option off
	  and run once to leave certification mode.

source "Kconfig.zephyr"
```

## sample.yaml
```
# SPDX-FileCopyrightText: Copyright (c) 2026 RAKwireless
# SPDX-License-Identifier: Apache-2.0

sample:
  name: RZI LoRaWAN certification (LCTT)
  description: >
    Put the LoRaWAN stack in certification mode so the LoRa Alliance
    Certification Test Tool can drive it
tests:
  sample.rzi.lorawan.lctt_certif:
    sysbuild: true
    build_only: true
    tags:
      - rzi
      - lorawan
    platform_allow:
      - rak4631/nrf52840/rzi
      - rak3172/stm32wle5xx/rzi
      - rak3362/nrf54l15/cpuapp
    integration_platforms:
      - rak4631/nrf52840/rzi
      - rak3172/stm32wle5xx/rzi
      - rak3362/nrf54l15/cpuapp
  sample.rzi.lorawan.lctt_certif.off:
    sysbuild: true
    build_only: true
    extra_configs:
      - CONFIG_APP_LCTT_CERTIFICATION=n
    tags:
      - rzi
      - lorawan
    platform_allow:
      - rak4631/nrf52840/rzi
      - rak3172/stm32wle5xx/rzi
      - rak3362/nrf54l15/cpuapp
    integration_platforms:
      - rak4631/nrf52840/rzi
      - rak3172/stm32wle5xx/rzi
      - rak3362/nrf54l15/cpuapp
```

## prj.conf
```kconfig
# SPDX-FileCopyrightText: Copyright (c) 2026 RAKwireless
# SPDX-License-Identifier: Apache-2.0

CONFIG_GPIO=y
CONFIG_SPI=y
CONFIG_FLASH=y
CONFIG_PM_DEVICE=y
CONFIG_TEST_RANDOM_GENERATOR=y

CONFIG_LOG=y
CONFIG_MAIN_STACK_SIZE=4096
CONFIG_HEAP_MEM_POOL_SIZE=8192

CONFIG_LORA=n
CONFIG_LORAWAN=n

CONFIG_RZI=y
CONFIG_RZI_LORAWAN=y
CONFIG_RZI_MCUBOOT=y
CONFIG_STREAM_FLASH=y
CONFIG_IMG_MANAGER=y
CONFIG_LORA_BASICS_MODEM_DRIVERS_EVENT_TRIGGER_NO_THREAD=y

# The LCTT exercises Class B, Class C and multicast.
CONFIG_LORA_BASICS_MODEM_CLASS_B=y
CONFIG_LORA_BASICS_MODEM_CLASS_C=y
CONFIG_LORA_BASICS_MODEM_MULTICAST=y
```

## app.overlay
```dts
/* SPDX-FileCopyrightText: Copyright (c) 2026 RAKwireless */
/* SPDX-License-Identifier: Apache-2.0 */
/*
 * Replace these placeholder credentials. Hardware is on rak4631/nrf52840/rzi.
 */

/ {
	zephyr,user {
		user-lorawan-device-eui = <0x00 0x00 0x00 0x00 0x00 0x00 0x00 0x00>;
		user-lorawan-join-eui = <0x00 0x00 0x00 0x00 0x00 0x00 0x00 0x00>;
		user-lorawan-gen_app-key = <0x00 0x00 0x00 0x00 0x00 0x00 0x00 0x00
					    0x00 0x00 0x00 0x00 0x00 0x00 0x00 0x00>;
		user-lorawan-app-key = <0x00 0x00 0x00 0x00 0x00 0x00 0x00 0x00
					0x00 0x00 0x00 0x00 0x00 0x00 0x00 0x00>;
	};
};
```

## src/main.c
```c
/* SPDX-FileCopyrightText: Copyright (c) 2026 RAKwireless */
/* SPDX-License-Identifier: Apache-2.0 */

#include <zephyr/devicetree.h>
#include <zephyr/kernel.h>
#include <zephyr/logging/log.h>
#include <rzi/lorawan/certification.h>
#include <rzi/lorawan/lorawan.h>

LOG_MODULE_REGISTER(rzi_lctt, LOG_LEVEL_INF);

#define USER_NODE      DT_PATH(zephyr_user)
#define LORAWAN_REGION RZI_LORAWAN_REGION_EU_868

static K_SEM_DEFINE(stack_ready, 0, 1);

static const char *tx_status_str(enum rzi_lorawan_tx_status status)
{
	switch (status) {
	case RZI_LORAWAN_EVENT_TXDONE_SENT:
		return "TXDONE_SENT";
	case RZI_LORAWAN_EVENT_TXDONE_CONFIRMED:
		return "TXDONE_CONFIRMED";
	case RZI_LORAWAN_EVENT_TXDONE_NOT_SENT:
		return "TXDONE_NOT_SENT";
	default:
		return "TXDONE_UNKNOWN";
	}
}

static void log_uplink_done(const struct rzi_lorawan_tx_result *tx)
{
	if (tx->error != 0) {
		LOG_WRN("%s: %s", tx_status_str(tx->status), rzi_err_str(tx->error));
		return;
	}
	LOG_INF("%s", tx_status_str(tx->status));
}

static const char *class_b_str(enum rzi_lorawan_class_b_state state)
{
	switch (state) {
	case RZI_LORAWAN_CLASS_B_IDLE:
		return "IDLE";
	case RZI_LORAWAN_CLASS_B_ACQUIRING_BEACON:
		return "ACQUIRING_BEACON";
	case RZI_LORAWAN_CLASS_B_ACQUIRING_PING_SLOT:
		return "ACQUIRING_PING_SLOT";
	case RZI_LORAWAN_CLASS_B_SWITCHING:
		return "SWITCHING";
	case RZI_LORAWAN_CLASS_B_ACTIVE:
		return "ACTIVE";
	default:
		return "CLASS_B_UNKNOWN";
	}
}

static void on_event(const struct rzi_lorawan_event *event, void *user_data)
{
	ARG_UNUSED(user_data);
	switch (event->type) {
	case RZI_LORAWAN_EVENT_READY:
		k_sem_give(&stack_ready);
		break;
	case RZI_LORAWAN_EVENT_STATE_CHANGED:
		if (event->state == RZI_LORAWAN_STATE_READY) {
			k_sem_give(&stack_ready);
		}
		break;
	case RZI_LORAWAN_EVENT_JOINED:
		LOG_INF("Joined");
		break;
	case RZI_LORAWAN_EVENT_JOIN_FAILED:
		LOG_WRN("Join failed: %s", rzi_err_str(event->error));
		break;
	case RZI_LORAWAN_EVENT_TXDONE:
		log_uplink_done(&event->tx);
		break;
	case RZI_LORAWAN_EVENT_DOWNDATA:
		LOG_INF("Downlink: port %u, %u bytes, RSSI %d dBm, SNR %d/4 dB",
			event->downlink.port, (unsigned int)event->downlink.size,
			event->downlink.rssi_dbm, event->downlink.snr_quarter_db);
		break;
	case RZI_LORAWAN_EVENT_CLASS_B:
		LOG_INF("CLASS_B: %s", class_b_str(event->class_b));
		break;
	case RZI_LORAWAN_EVENT_ERROR:
		LOG_ERR("Error: %s", rzi_err_str(event->error));
		break;
	default:
		break;
	}
}

static const struct rzi_lorawan_callbacks callbacks = {
	.on_event = on_event,
};

int main(void)
{
	static const uint8_t dev_eui[] = DT_PROP(USER_NODE, user_lorawan_device_eui);
	static const uint8_t join_eui[] = DT_PROP(USER_NODE, user_lorawan_join_eui);
	static const uint8_t app_key[] = DT_PROP(USER_NODE, user_lorawan_app_key);
	static const uint8_t gen_app_key[] = DT_PROP(USER_NODE, user_lorawan_gen_app_key);
	const bool wanted = IS_ENABLED(CONFIG_APP_LCTT_CERTIFICATION);
	bool enabled = false;
	int rc;

	LOG_INF("RZI LoRaWAN certification (LCTT) sample");
	rc = rzi_lorawan_register_callbacks(&callbacks);
	if (rc != 0) {
		LOG_ERR("Callback registration failed: %s", rzi_err_str(rc));
		return rc;
	}
	rc = rzi_lorawan_set_dev_eui(dev_eui, sizeof(dev_eui));
	if (rc != 0) {
		LOG_ERR("Credentials failed: %s", rzi_err_str(rc));
		return rc;
	}
	rc = rzi_lorawan_set_app_eui(join_eui, sizeof(join_eui));
	if (rc != 0) {
		LOG_ERR("Credentials failed: %s", rzi_err_str(rc));
		return rc;
	}
	rc = rzi_lorawan_set_app_key(app_key, sizeof(app_key));
	if (rc != 0) {
		LOG_ERR("Credentials failed: %s", rzi_err_str(rc));
		return rc;
	}
	rc = rzi_lorawan_set_gen_app_key(gen_app_key, sizeof(gen_app_key));
	if (rc != 0) {
		LOG_ERR("Credentials failed: %s", rzi_err_str(rc));
		return rc;
	}
	rc = rzi_lorawan_set_activation(RZI_LORAWAN_ACTIVATION_OTAA);
	if (rc != 0) {
		LOG_ERR("Credentials failed: %s", rzi_err_str(rc));
		return rc;
	}
	rc = rzi_lorawan_init(LORAWAN_REGION);
	if (rc != 0) {
		LOG_ERR("LoRaWAN init failed: %s", rzi_err_str(rc));
		return rc;
	}

	k_sem_take(&stack_ready, K_FOREVER);

	rc = rzi_lorawan_get_certification_mode(&enabled);
	if (rc != 0) {
		LOG_ERR("Certification mode failed: %s", rzi_err_str(rc));
		return rc;
	}
	if (enabled != wanted) {
		rc = rzi_lorawan_set_certification_mode(wanted);
		if (rc != 0) {
			LOG_ERR("Certification mode failed: %s", rzi_err_str(rc));
			return rc;
		}
	}
	if (wanted) {
		LOG_INF("Certification mode on; the stack joins and the LCTT takes over");
	} else {
		LOG_INF("Certification mode off; flash another sample now");
	}
	return 0;
}
```
