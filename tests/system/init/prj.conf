## CMakeLists.txt
```
# SPDX-FileCopyrightText: Copyright (c) 2026 RAKwireless
# SPDX-License-Identifier: Apache-2.0

cmake_minimum_required(VERSION 3.20.0)
find_package(Zephyr REQUIRED HINTS $ENV{ZEPHYR_BASE})
project(rzi_init_test)

target_sources(app PRIVATE src/main.c)
```

## prj.conf
```kconfig
# SPDX-FileCopyrightText: Copyright (c) 2026 RAKwireless
# SPDX-License-Identifier: Apache-2.0

CONFIG_ZTEST=y
CONFIG_RZI=y
CONFIG_RZI_POWER=y
CONFIG_RZI_STORAGE=y
```

## src/main.c
```c
/* SPDX-FileCopyrightText: Copyright (c) 2026 RAKwireless */
/* SPDX-License-Identifier: Apache-2.0 */

#include <stdint.h>

#include <zephyr/ztest.h>

#include <rzi/err.h>
#include <rzi/init.h>
#include <rzi/power/power.h>
#include <rzi/storage/storage.h>

ZTEST(rzi_system_init, test_init_prepares_compiled_services)
{
	bool enabled;
	uint8_t value = 0U;

	zassert_ok(rzi_init());
	zassert_ok(rzi_init());
	zassert_ok(rzi_power_get_pm_enabled(&enabled));
	zassert_equal(enabled, IS_ENABLED(CONFIG_PM));
	zassert_equal(rzi_storage_read("rzi", "missing", &value, sizeof(value)),
		      -RZI_ERR_NOT_FOUND);
}

ZTEST_SUITE(rzi_system_init, NULL, NULL, NULL, NULL, NULL);
```
