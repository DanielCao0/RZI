## zephyr/Kconfig.at
```kconfig
# SPDX-License-Identifier: Apache-2.0

config RZI_AT
	bool "RUI3-compatible AT command framework"
	select REBOOT
	help
	  Enable the I/O-independent AT parser, command registry,
	  response formatter and execution thread. Command packages and
	  I/O adapters are selected independently below.

if RZI_AT

config RZI_AT_COMMAND_LORAWAN
	bool "LoRaWAN AT command package"
	depends on RZI_LORAWAN
	default n
	help
	  Enable the RUI3-compatible LoRaWAN command subset. This package is
	  a client of the public RZI LoRaWAN API.

config RZI_AT_COMMAND_LORA
	bool "Raw LoRa and FSK AT command package scaffold"
	depends on RZI_LORA
	default n

config RZI_AT_ADAPTER_UART
	bool "UART AT I/O adapter"
	depends on SERIAL
	select UART_INTERRUPT_DRIVEN
	default n
	help
	  Bind the AT framework to one application-selected interrupt UART.

config RZI_AT_MAX_COMMANDS
	int "Maximum registered AT commands"
	range 8 256
	default 32

config RZI_AT_MAX_EXTENSIONS
	int "Maximum AT command extensions"
	range 1 16
	default 4

config RZI_AT_LINE_MAX
	int "Maximum AT input line length"
	range 64 2048
	default 600

config RZI_AT_RX_BUFFER_SIZE
	int "AT receive ring buffer size"
	range 128 4096
	default 1024

config RZI_AT_TX_BUFFER_SIZE
	int "AT response formatting buffer size"
	range 128 2048
	default 640

config RZI_AT_THREAD_STACK_SIZE
	int "AT execution thread stack size"
	range 1024 8192
	default 2048

config RZI_AT_THREAD_PRIORITY
	int "AT execution thread preemptive priority"
	range 0 15
	default 14

config RZI_AT_PROCESS_INTERVAL_MS
	int "AT extension processing interval in milliseconds"
	range 1 1000
	default 20

config RZI_AT_ECHO
	bool "Echo AT input characters"
	default y
	help
	  Echo printable input and line editing characters using RUI3-style
	  terminal behavior. Disable this when the host performs local echo.

config RZI_AT_NVM
	bool "Persist LoRaWAN AT parameters in flash"
	depends on RZI_AT_COMMAND_LORAWAN
	select RZI_STORAGE
	select NVS
	select FLASH_MAP
	help
	  Persist the AT parameters (DEVEUI, APPEUI, APPKEY, BAND, CFM and
	  JOIN auto-join settings) through the RZI storage service, and
	  enable ATR to restore the devicetree defaults. The application
	  selects the Zephyr settings backend itself (CONFIG_SETTINGS_NVS=y
	  recommended). RZI never hardcodes flash addresses.

endif # RZI_AT
```

## zephyr/Kconfig.llext_exports
```kconfig
# SPDX-FileCopyrightText: Copyright (c) 2026 RAKwireless
# SPDX-License-Identifier: Apache-2.0

config RZI_LLEXT_EXPORTS
	bool "Export the RZI API to LLEXT extensions"
	depends on LLEXT
	help
	  Add the public RZI functions of the enabled RZI services to the
	  LLEXT export table, so extensions can call them.
```

## zephyr/Kconfig.lora
```kconfig
# SPDX-License-Identifier: Apache-2.0

config RZI_LORA
	bool "RZI raw LoRa and FSK service"
	help
	  Enable the backend-independent RZI raw LoRa and FSK service used by
	  P2P AT commands and radio certification tests.

if RZI_LORA

choice RZI_LORA_BACKEND
	prompt "Raw LoRa backend"
	default RZI_LORA_BACKEND_TEST if ZTEST
	default RZI_LORA_BACKEND_USP if RZI_LORAWAN_BACKEND_USP
	default RZI_LORA_BACKEND_ZEPHYR if LORA

config RZI_LORA_BACKEND_TEST
	bool "In-process test backend"
	depends on ZTEST
	help
	  Software loopback used by host tests. Do not use this option in
	  production firmware.

config RZI_LORA_BACKEND_USP
	bool "Semtech USP radio access controller"
	depends on RZI_LORAWAN_BACKEND_USP
	select RZI_USP
	help
	  Run P2P send and receive as USP radio access controller (RAC)
	  transactions below LoRaWAN priority, so P2P and LoRaWAN share the
	  radio. Radio certification tests (CW, PER, RSSI) use the LoRa Basics
	  Modem test mode, which suspends LoRaWAN until rzi_lora_stop().

config RZI_LORA_BACKEND_ZEPHYR
	bool "Zephyr LoRa driver"
	depends on LORA
	help
	  Use Zephyr's public <zephyr/drivers/lora.h> driver. This cannot be
	  combined with CONFIG_RZI_LORAWAN_BACKEND_USP.

endchoice

endif # RZI_LORA
```

## zephyr/Kconfig.lorawan
```kconfig
# SPDX-License-Identifier: Apache-2.0

config RZI_LORAWAN
	bool "RZI LoRaWAN service"
	depends on FLASH
	help
	  Enable the backend-independent RZI LoRaWAN service API.

if RZI_LORAWAN

choice RZI_LORAWAN_BACKEND
	prompt "LoRaWAN backend"
	default RZI_LORAWAN_BACKEND_USP

config RZI_LORAWAN_BACKEND_USP
	bool "Semtech USP and LoRa Basics Modem"
	select LORA_BASICS_MODEM_DRIVERS
	select USP
	select USP_LORA_BASICS_MODEM
	select USP_MAIN_THREAD
	select USP_THREADS_MUTEXES
	help
	  Use the Semtech USP and LoRa Basics Modem implementation. RZI owns
	  the modem; applications must not call Semtech APIs directly. Keep
	  CONFIG_LORA=n and CONFIG_LORAWAN=n so Zephyr does not drive the
	  same radio. Do not depend on !LORA here: this choice also has a
	  Zephyr option that selects LORA, and kconfiglib recurses.

config RZI_LORAWAN_BACKEND_ZEPHYR
	bool "Zephyr LoRaWAN API"
	select LORA
	select LORAWAN
	help
	  Use Zephyr's public <zephyr/lorawan/lorawan.h> stack. The LoRa
	  module backend must be loramac-node; set
	  CONFIG_LORA_MODULE_BACKEND_LORAMAC_NODE=y. Native and LoRa Basics
	  Modem radio backends are not supported. RZI owns the stack;
	  applications must not call lorawan_* APIs directly. This is not
	  the planned Zephyr LBM LoRaWAN backend.

config RZI_LORAWAN_BACKEND_TEST
	bool "In-process test backend"
	depends on ZTEST
	help
	  Select a backend supplied by a RZI unit-test application. Do not use
	  this option in production firmware.

endchoice

if RZI_LORAWAN_BACKEND_ZEPHYR

config RZI_LORAWAN_ZEPHYR_WORKER_STACK_SIZE
	int "Zephyr backend worker stack size"
	range 1024 8192
	default 2048
	help
	  Stack for the thread that runs blocking Zephyr lorawan_join()
	  and lorawan_send() calls.

config RZI_LORAWAN_ZEPHYR_WORKER_PRIORITY
	int "Zephyr backend worker preemptive priority"
	range 0 15
	default 11

endif

config RZI_LORAWAN_EVENT_QUEUE_SIZE
	int "LoRaWAN event queue depth"
	range 4 64
	default 8

config RZI_LORAWAN_MAX_CALLBACKS
	int "Maximum LoRaWAN callback subscribers"
	range 1 16
	default 4

config RZI_LORAWAN_DISPATCHER_STACK_SIZE
	int "LoRaWAN callback dispatcher stack size"
	range 1024 8192
	default 2048

config RZI_LORAWAN_DISPATCHER_PRIORITY
	int "LoRaWAN callback dispatcher preemptive priority"
	range 0 15
	default 10

menu "Reserved LoRaWAN features"

config RZI_LORAWAN_MULTICAST
	bool "Multicast service scaffold"

config RZI_LORAWAN_LINK_CHECK
	bool "LinkCheckReq MAC command scaffold"

config RZI_LORAWAN_FUOTA
	bool "LoRaWAN FUOTA coordination"
	select LORA_BASICS_MODEM_FUOTA if RZI_LORAWAN_BACKEND_USP
	imply LORAWAN_SERVICES if RZI_LORAWAN_BACKEND_ZEPHYR
	imply LORAWAN_APP_CLOCK_SYNC if RZI_LORAWAN_BACKEND_ZEPHYR
	imply LORAWAN_FRAG_TRANSPORT if RZI_LORAWAN_BACKEND_ZEPHYR
	imply LORAWAN_REMOTE_MULTICAST if RZI_LORAWAN_BACKEND_ZEPHYR
	help
	  Enable backend-independent FUOTA coordination for ChirpStack and
	  other LoRaWAN FUOTA servers. Clock Synchronization, Remote
	  Multicast Setup and Fragmentation stay inside the selected
	  backend. RZI owns session state, image access and optional
	  MCUboot installation.

if RZI_LORAWAN_FUOTA

config RZI_FUOTA_KEEPALIVE_INTERVAL_S
	int "Unicast keepalive interval in seconds"
	range 0 86400
	default 0
	help
	  ChirpStack advances FUOTA unicast steps after the device-profile
	  expected uplink interval. Set a non-zero value to send a one-byte
	  keepalive automatically. Zero disables the timer so the
	  application can send its own periodic uplinks.

config RZI_FUOTA_KEEPALIVE_PORT
	int "Keepalive LoRaWAN port"
	range 1 223
	default 2
	depends on RZI_FUOTA_KEEPALIVE_INTERVAL_S > 0

config RZI_FUOTA_AUTO_APPLY
	bool "Apply a completed image automatically"
	depends on IMG_MANAGER
	help
	  Copy a reconstructed MCUboot image to the secondary slot and
	  reboot after a successful transfer or an FMP reboot request.

config RZI_FUOTA_HW_VERSION
	hex "Hardware version reported to FMP"
	default 0x1
	help
	  32-bit hardware version returned to the Firmware Management
	  Package. ChirpStack FUOTA does not require FMP.

endif # RZI_LORAWAN_FUOTA

config RZI_LORAWAN_DEVICE_TIME
	bool "DeviceTimeReq MAC command scaffold"

config RZI_LORAWAN_CHANNEL_SCAN
	bool "Channel-scan service scaffold"

config RZI_LORAWAN_CERTIFICATION
	bool "Certification service scaffold"

endmenu

endif # RZI_LORAWAN
```

## zephyr/Kconfig.power
```kconfig
# SPDX-FileCopyrightText: Copyright (c) 2026 RAKwireless
# SPDX-License-Identifier: Apache-2.0

config RZI_POWER
	bool "RZI power helpers"
	help
	  Service PM locks, a runtime switch for native Zephyr PM locks,
	  and thread waits. Enable CONFIG_PM in the
	  application to use system PM; Zephyr's policy and the SoC device
	  tree select the actual state. Ordinary CPU idle works without PM.

if RZI_POWER

config RZI_POWER_AUTO_SERVICE_LOCK
	bool "Services acquire PM locks automatically"
	default y
	help
	  Class C, storage writes, and FUOTA transfer/apply take and
	  release PM locks. Class A join/send do not: the backend must be
	  allowed to STOP between TX and RX1/RX2. Disable only when the
	  application owns every PM lock itself.

endif # RZI_POWER
```

## zephyr/Kconfig.rsup
```kconfig
# SPDX-License-Identifier: Apache-2.0

config RZI_RSUP
	bool "RSUP (RZI Slot Update Protocol)"
	depends on RZI_MCUBOOT && RZI_MCUBOOT_DUAL_SLOT && SERIAL && FLASH && FLASH_MAP
	select REBOOT
	select CRC
	select IMG_MANAGER
	select STREAM_FLASH
	help
	  Accept RSUP on a Zephyr UART and install a signed MCUboot image
	  into slot1. The UART can be USB CDC or a hardware serial port;
	  set chosen rzi,rsup-uart. Type 0 (Arduino sketch) is not
	  handled here.

config RZI_SLOT_UPDATE
	bool
	select RZI_RSUP
	help
	  Deprecated alias for CONFIG_RZI_RSUP. Do not use in new
	  configuration files.

config RZI_USB_UPDATE
	bool
	select RZI_RSUP
	help
	  Deprecated alias for CONFIG_RZI_RSUP. Do not use in new
	  configuration files.

if RZI_RSUP

config RZI_RSUP_1200BPS
	bool "Enter update when the selected UART baud is 1200"
	depends on UART_LINE_CTRL
	default y
	help
	  Poll the bound UART. 1200 baud arms GPREGRET and resets. Works
	  on CDC and on hardware UARTs that implement line control.

config RZI_RSUP_HEADER_TIMEOUT_MS
	int "Milliseconds to wait for an RSUP header after the port is ready"
	range 1000 300000
	default 120000

endif
```

## zephyr/Kconfig.slot_update
```kconfig
# SPDX-License-Identifier: Apache-2.0

config RZI_SLOT_UPDATE
	bool "UART slot update (RZI1)"
	depends on RZI_MCUBOOT && SERIAL && FLASH && FLASH_MAP
	select REBOOT
	select CRC
	select IMG_MANAGER
	select STREAM_FLASH
	help
	  Accept the RZI1 byte protocol on a Zephyr UART and install a
	  signed MCUboot image into slot1. The UART can be USB CDC or a
	  hardware serial port; set chosen rzi,slot-update-uart.
	  Type 0 (Arduino sketch) is not handled here.

config RZI_USB_UPDATE
	bool
	select RZI_SLOT_UPDATE
	help
	  Deprecated alias for CONFIG_RZI_SLOT_UPDATE.

if RZI_SLOT_UPDATE

config RZI_SLOT_UPDATE_1200BPS
	bool "Enter update when the selected UART baud is 1200"
	depends on UART_LINE_CTRL
	default y
	help
	  Poll the bound UART. 1200 baud arms GPREGRET and resets. Works
	  on CDC and on hardware UARTs that implement line control.

config RZI_SLOT_UPDATE_HEADER_TIMEOUT_MS
	int "Milliseconds to wait for an RZI1 header after the port is ready"
	range 1000 300000
	default 120000

endif
```

## zephyr/Kconfig.storage
```kconfig
# SPDX-FileCopyrightText: Copyright (c) 2026 RAKwireless
# SPDX-License-Identifier: Apache-2.0

config RZI_STORAGE
	bool "RZI storage service"
	select SETTINGS
	select CRC
	help
	  Enable the backend-neutral RZI key-value storage API. The current
	  Zephyr integration uses the settings subsystem.

config RZI_STORAGE_RECORD_MAX_SIZE
	int "Maximum versioned record payload size"
	depends on RZI_STORAGE
	range 16 2048
	default 256
	help
	  Bound the scratch buffer used to validate versioned records. The
	  selected storage backend may impose a smaller per-value limit.
```
