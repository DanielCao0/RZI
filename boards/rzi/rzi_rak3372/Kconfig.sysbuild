## boards/rzi/rzi_rak3372/Kconfig.sysbuild
```kconfig
# SPDX-License-Identifier: Apache-2.0

choice MCUBOOT_MODE
	default MCUBOOT_MODE_SINGLE_APP
endchoice
```

## boards/rzi/rzi_rak3372/board.yml
```yaml
board:
  name: rzi_rak3372
  full_name: RZI RAK3372
  vendor: rzi
  socs:
  - name: stm32wle5xx
```

## boards/rzi/rzi_rak4631/board.yml
```yaml
board:
  name: rzi_rak4631
  full_name: RZI RAK4631
  vendor: rzi
  socs:
  - name: nrf52840
```

## samples/lora/ping_pong/Kconfig
```kconfig
# SPDX-License-Identifier: Apache-2.0

mainmenu "RZI LoRa ping-pong sample"

config APP_PING_PONG_MANAGER
	bool "Act as the manager"
	help
	  The manager sends PING and waits for PONG; the subordinate answers
	  every PING with PONG. Build one board with this option and one
	  without it.

config APP_PING_PONG_FREQUENCY_HZ
	int "Carrier frequency in hertz"
	default 868100000

config APP_PING_PONG_SPREADING_FACTOR
	int "LoRa spreading factor"
	range 5 12
	default 9

config APP_PING_PONG_TX_POWER_DBM
	int "Transmit power in dBm"
	range 5 22
	default 14

config APP_PING_PONG_RX_TIMEOUT_MS
	int "Time the manager waits for PONG, in milliseconds"
	default 1000

config APP_PING_PONG_DELAY_MS
	int "Pause between two exchanges on the manager, in milliseconds"
	default 250

config APP_PING_PONG_REPLY_DELAY_MS
	int "Delay before the subordinate sends PONG, in milliseconds"
	default 50
	help
	  Leaves the manager time to switch from transmit to receive after
	  its PING.

source "Kconfig.zephyr"
```

## samples/lora/ping_pong/sample.yaml
```yaml
# SPDX-FileCopyrightText: Copyright (c) 2026 RAKwireless
# SPDX-License-Identifier: Apache-2.0

sample:
  name: RZI LoRa ping-pong
  description: >
    Exchange PING and PONG frames between two boards through the RZI raw
    LoRa API
tests:
  sample.rzi.lora.ping_pong.subordinate:
    sysbuild: true
    build_only: true
    tags:
      - rzi
      - lora
    platform_allow:
      - rak4631/nrf52840/rzi
      - rak3172/stm32wle5xx/rzi
      - rak3362/nrf54l15/cpuapp
    integration_platforms:
      - rak4631/nrf52840/rzi
      - rak3172/stm32wle5xx/rzi
      - rak3362/nrf54l15/cpuapp
  sample.rzi.lora.ping_pong.manager:
    sysbuild: true
    build_only: true
    extra_configs:
      - CONFIG_APP_PING_PONG_MANAGER=y
    tags:
      - rzi
      - lora
    platform_allow:
      - rak4631/nrf52840/rzi
      - rak3172/stm32wle5xx/rzi
      - rak3362/nrf54l15/cpuapp
    integration_platforms:
      - rak4631/nrf52840/rzi
      - rak3172/stm32wle5xx/rzi
      - rak3362/nrf54l15/cpuapp
```

## samples/lora/spectral_scan/Kconfig
```kconfig
# SPDX-FileCopyrightText: Copyright (c) 2026 RAKwireless
# SPDX-License-Identifier: Apache-2.0

mainmenu "RZI LoRa spectral scan sample"

config APP_SCAN_START_HZ
	int "First channel frequency in hertz"
	default 866500000

config APP_SCAN_CHANNELS
	int "Number of channels"
	range 1 64
	default 3

config APP_SCAN_STEP_HZ
	int "Channel spacing in hertz"
	default 1000000

config APP_SCAN_SAMPLES
	int "RSSI samples per channel"
	range 1 1000
	default 20
	help
	  Each sample is itself a 100 ms RSSI average, so one channel takes
	  roughly this many tenths of a second.

config APP_SCAN_INTERVAL_S
	int "Pause between sweeps in seconds"
	default 10
	help
	  Zero runs a single sweep.

source "Kconfig.zephyr"
```

## samples/lora/spectral_scan/sample.yaml
```yaml
# SPDX-FileCopyrightText: Copyright (c) 2026 RAKwireless
# SPDX-License-Identifier: Apache-2.0

sample:
  name: RZI LoRa spectral scan
  description: >
    Sweep a frequency range and report the channel RSSI through the RZI raw
    LoRa test API
tests:
  sample.rzi.lora.spectral_scan:
    sysbuild: true
    build_only: true
    tags:
      - rzi
      - lora
    platform_allow:
      - rak4631/nrf52840/rzi
      - rak3172/stm32wle5xx/rzi
      - rak3362/nrf54l15/cpuapp
    integration_platforms:
      - rak4631/nrf52840/rzi
      - rak3172/stm32wle5xx/rzi
      - rak3362/nrf54l15/cpuapp
```

## samples/lora/tx_cw/Kconfig
```kconfig
# SPDX-License-Identifier: Apache-2.0

mainmenu "RZI continuous-wave test sample"

config APP_TX_CW_FREQUENCY_HZ
	int "Carrier frequency in hertz"
	default 868100000

config APP_TX_CW_POWER_DBM
	int "Transmit power in dBm"
	range -9 22
	default 14

config APP_TX_CW_DURATION_S
	int "Carrier duration in seconds"
	default 10
	help
	  The carrier stops after this many seconds. Zero keeps it on until
	  the board is reset.

source "Kconfig.zephyr"
```

## samples/lora/tx_cw/sample.yaml
```yaml
# SPDX-FileCopyrightText: Copyright (c) 2026 RAKwireless
# SPDX-License-Identifier: Apache-2.0

sample:
  name: RZI LoRa continuous wave
  description: >
    Transmit an unmodulated carrier through the RZI raw LoRa API for RF
    measurements
tests:
  sample.rzi.lora.tx_cw:
    sysbuild: true
    build_only: true
    tags:
      - rzi
      - lora
    platform_allow:
      - rzi_rak4631/nrf52840
      - rzi_rak3372/stm32wle5xx
      - rzi_rak3362/nrf54l15/cpuapp
    integration_platforms:
      - rzi_rak4631/nrf52840
      - rzi_rak3372/stm32wle5xx
      - rzi_rak3362/nrf54l15/cpuapp
```

## tests/at/commands/lorawan/testcase.yaml
```yaml
# SPDX-FileCopyrightText: Copyright (c) 2026 RAKwireless
# SPDX-License-Identifier: Apache-2.0
tests:
  rzi.at.commands.lorawan:
    tags:
      - rzi
      - at
      - lorawan
    platform_allow:
      - native_sim
    integration_platforms:
      - native_sim
  rzi.at.commands.lorawan.storage:
    tags: [rzi, at, lorawan, storage]
    platform_allow: [native_sim]
    integration_platforms: [native_sim]
    extra_configs:
      - CONFIG_RZI_STORAGE=y
      - CONFIG_FLASH_MAP=y
      - CONFIG_NVS=y
      - CONFIG_SETTINGS_NVS=y
      - CONFIG_MAIN_STACK_SIZE=4096
  rzi.at.commands.lorawan.at_nvm:
    tags: [rzi, at, lorawan, storage]
    platform_allow: [native_sim]
    integration_platforms: [native_sim]
    extra_configs:
      - CONFIG_RZI_AT_NVM=y
      - CONFIG_SETTINGS_NVS=y
      - CONFIG_MAIN_STACK_SIZE=4096
```

## tests/at/core/testcase.yaml
```yaml
# SPDX-License-Identifier: Apache-2.0
tests:
  rzi.at.core:
    tags:
      - rzi
      - at
    platform_allow:
      - native_sim/native/64
    integration_platforms:
      - native_sim/native/64
  rzi.at.core.raw_lora_scaffold:
    tags:
      - rzi
      - at
      - lora
    platform_allow:
      - native_sim/native/64
    extra_configs:
      - CONFIG_RZI_LORA=y
      - CONFIG_RZI_AT_COMMAND_LORA=y
```

## tests/at/framework/testcase.yaml
```yaml
# SPDX-FileCopyrightText: Copyright (c) 2026 RAKwireless
# SPDX-License-Identifier: Apache-2.0
tests:
  rzi.at.framework:
    tags:
      - rzi
      - at
    platform_allow:
      - native_sim/native/64
    integration_platforms:
      - native_sim/native/64
  rzi.at.framework.raw_lora:
    tags:
      - rzi
      - at
      - lora
    platform_allow:
      - native_sim/native/64
    integration_platforms:
      - native_sim/native/64
    extra_configs:
      - CONFIG_RZI_LORA=y
      - CONFIG_RZI_AT_COMMAND_LORA=y
  rzi.at.framework.power:
    tags:
      - rzi
      - at
      - power
    platform_allow:
      - native_sim/native/64
    integration_platforms:
      - native_sim/native/64
    extra_configs:
      - CONFIG_RZI_POWER=y
      - CONFIG_PM=y
    extra_args:
      - DTC_OVERLAY_FILE=../../power/api/pm.overlay
  rzi.at.framework.power_no_pm:
    tags:
      - rzi
      - at
      - power
    platform_allow:
      - native_sim/native/64
    integration_platforms:
      - native_sim/native/64
    extra_configs:
      - CONFIG_RZI_POWER=y
```

## tests/at/lorawan_command/testcase.yaml
```yaml
tests:
  rzi.at.lorawan_command:
    tags:
      - rzi
      - at
      - lorawan
    platform_allow:
      - native_sim
```

## tests/core/err/testcase.yaml
```yaml
# SPDX-License-Identifier: Apache-2.0

tests:
  rzi.core.err:
    platform_allow:
      - native_sim
    tags:
      - rzi
      - err
```

## tests/lorawan/backend/zephyr/testcase.yaml
```yaml
# SPDX-FileCopyrightText: Copyright (c) 2026 RAKwireless
# SPDX-License-Identifier: Apache-2.0

tests:
  rzi.lorawan.backend.zephyr:
    tags:
      - rzi
      - lorawan
    platform_allow:
      - native_sim
    integration_platforms:
      - native_sim
```

## tests/lorawan/backend_zephyr/testcase.yaml
```yaml
# SPDX-License-Identifier: Apache-2.0

tests:
  rzi.lorawan.backend.zephyr:
    tags:
      - rzi
      - lorawan
    platform_allow:
      - native_sim
```

## tests/lorawan/core/testcase.yaml
```yaml
tests:
  rzi.lorawan.core:
    tags:
      - rzi
      - lorawan
    platform_allow:
      - native_sim
  rzi.lorawan.core.all_scaffolds:
    tags:
      - rzi
      - lorawan
    platform_allow:
      - native_sim
    extra_configs:
      - CONFIG_RZI_LORAWAN_FUOTA=y
```

## tests/lorawan/fuota/testcase.yaml
```yaml
# SPDX-FileCopyrightText: Copyright (c) 2026 RAKwireless
# SPDX-License-Identifier: Apache-2.0
tests:
  rzi.lorawan.fuota:
    tags:
      - rzi
      - lorawan
      - fuota
    platform_allow:
      - native_sim
    integration_platforms:
      - native_sim
```

## tests/lorawan/service/testcase.yaml
```yaml
# SPDX-FileCopyrightText: Copyright (c) 2026 RAKwireless
# SPDX-License-Identifier: Apache-2.0
tests:
  rzi.lorawan.service:
    tags:
      - rzi
      - lorawan
    platform_allow:
      - native_sim
    integration_platforms:
      - native_sim
  rzi.lorawan.service.all_scaffolds:
    tags:
      - rzi
      - lorawan
    platform_allow:
      - native_sim
    integration_platforms:
      - native_sim
    extra_configs:
      - CONFIG_RZI_LORAWAN_FUOTA=y
  rzi.lorawan.service.power:
    tags:
      - rzi
      - lorawan
      - power
    platform_allow:
      - native_sim
    integration_platforms:
      - native_sim
    extra_configs:
      - CONFIG_RZI_POWER=y
```

## tests/lorawan/settings/testcase.yaml
```yaml
# SPDX-FileCopyrightText: Copyright (c) 2026 RAKwireless
# SPDX-License-Identifier: Apache-2.0
tests:
  rzi.lorawan.settings:
    tags: [rzi, lorawan, storage]
    platform_allow: [native_sim]
    integration_platforms: [native_sim]
```

## tests/power/api/testcase.yaml
```yaml
# SPDX-FileCopyrightText: Copyright (c) 2026 RAKwireless
# SPDX-License-Identifier: Apache-2.0

common:
  platform_allow:
    - native_sim
  integration_platforms:
    - native_sim
  tags:
    - rzi
    - power

tests:
  rzi.power.api: {}
  rzi.power.api.pm:
    extra_configs:
      - CONFIG_PM=y
    extra_args:
      - DTC_OVERLAY_FILE=pm.overlay
  rzi.power.api.hwinfo:
    extra_configs:
      - CONFIG_HWINFO=y
      - CONFIG_HWINFO_NATIVE=n
      - CONFIG_TEST_HWINFO_MOCK=y
  rzi.power.api.no_hwinfo:
    extra_configs:
      - CONFIG_HWINFO=n
```

## tests/storage/api/testcase.yaml
```yaml
# SPDX-FileCopyrightText: Copyright (c) 2026 RAKwireless
# SPDX-License-Identifier: Apache-2.0

tests:
  rzi.storage.api:
    platform_allow:
      - native_sim
    integration_platforms:
      - native_sim
    tags:
      - rzi
      - storage
  rzi.storage.api.power:
    platform_allow:
      - native_sim
    integration_platforms:
      - native_sim
    tags:
      - rzi
      - storage
      - power
    extra_configs:
      - CONFIG_RZI_POWER=y
  rzi.storage.api.nvs:
    platform_allow:
      - native_sim
    integration_platforms:
      - native_sim
    tags:
      - rzi
      - storage
      - power
    extra_configs:
      - CONFIG_FLASH=y
      - CONFIG_FLASH_MAP=y
      - CONFIG_NVS=y
      - CONFIG_SETTINGS_NVS=y
      - CONFIG_RZI_POWER=y
      - CONFIG_MAIN_STACK_SIZE=4096
    extra_args:
      - DTC_OVERLAY_FILE=nvs.overlay
```

## tests/system/error/testcase.yaml
```yaml
# SPDX-FileCopyrightText: Copyright (c) 2026 RAKwireless
# SPDX-License-Identifier: Apache-2.0

tests:
  rzi.system.error:
    platform_allow:
      - native_sim
    integration_platforms:
      - native_sim
    tags:
      - rzi
      - err
```
