## boards/rakwireless/rak3172/Kconfig.sysbuild
```kconfig
# SPDX-FileCopyrightText: Copyright (c) 2026 RAKwireless
# SPDX-License-Identifier: Apache-2.0

choice MCUBOOT_MODE
	default MCUBOOT_MODE_SINGLE_APP if BOARD_RAK3172_STM32WLE5XX_RZI
endchoice
```

## boards/rakwireless/rak3172/board.yml
```yaml
# SPDX-FileCopyrightText: Copyright (c) 2026 RAKwireless
# SPDX-License-Identifier: Apache-2.0

board:
  extend: rak3172
  variants:
    - name: rzi
      qualifier: stm32wle5xx
```

## boards/rakwireless/rak3362/Kconfig.defconfig
```kconfig
# SPDX-FileCopyrightText: Copyright (c) 2026 RAKwireless
# SPDX-License-Identifier: Apache-2.0

if BOARD_RAK3362_NRF54L15_CPUAPP

config HAS_BT_CTLR
	default BT

endif # BOARD_RAK3362_NRF54L15_CPUAPP
```

## boards/rakwireless/rak3362/rak3362_nrf54l15_cpuapp_defconfig
```kconfig
# SPDX-FileCopyrightText: Copyright (c) 2026 RAKwireless
# SPDX-License-Identifier: Apache-2.0

CONFIG_ARM_MPU=y
CONFIG_HW_STACK_PROTECTION=y
CONFIG_NULL_POINTER_EXCEPTION_DETECTION_NONE=y
CONFIG_CACHE_MANAGEMENT=y
CONFIG_EXTERNAL_CACHE=y
CONFIG_NRF_GRTC_START_SYSCOUNTER=y
CONFIG_GPIO=y
CONFIG_SERIAL=y
CONFIG_CONSOLE=y
CONFIG_UART_CONSOLE=y
```

## boards/rakwireless/rak3372_f/board.yml
```yaml
# SPDX-FileCopyrightText: Copyright (c) 2026 RAKwireless
# SPDX-License-Identifier: Apache-2.0
board:
  name: rak3372_f
  full_name: RAK3372-F
  vendor: rakwireless
  socs:
  - name: stm32wle5xx
```

## boards/rakwireless/rak4631/Kconfig.defconfig
```kconfig
# SPDX-FileCopyrightText: Copyright (c) 2026 RAKwireless
# SPDX-License-Identifier: Apache-2.0

if BOARD_RAK4631_NRF52840_RZI

config RZI_MCUBOOT_DUAL_SLOT
	default y if RZI_MCUBOOT

endif
```

## boards/rakwireless/rak4631/Kconfig.sysbuild
```kconfig
# SPDX-FileCopyrightText: Copyright (c) 2026 RAKwireless
# SPDX-License-Identifier: Apache-2.0

choice MCUBOOT_MODE
	default MCUBOOT_MODE_OVERWRITE_ONLY if BOARD_RAK4631_NRF52840_RZI
endchoice
```

## boards/rakwireless/rak4631/board.yml
```yaml
# SPDX-FileCopyrightText: Copyright (c) 2026 RAKwireless
# SPDX-License-Identifier: Apache-2.0

board:
  extend: rak4631
  variants:
    - name: rzi
      qualifier: nrf52840
```

## boards/rakwireless/rzi_rak3172_f/board.yml
```yaml
# SPDX-FileCopyrightText: Copyright (c) 2026 RAKwireless
# SPDX-License-Identifier: Apache-2.0
board:
  name: rzi_rak3172_f
  full_name: RZI RAK3172-F
  vendor: rakwireless
  socs:
  - name: stm32wle5xx
```

## boards/rakwireless/rzi_rak3362/Kconfig.rzi_rak3362
```kconfig
# SPDX-License-Identifier: Apache-2.0

config BOARD_RZI_RAK3362
	select SOC_NRF54L15_CPUAPP if BOARD_RZI_RAK3362_NRF54L15_CPUAPP
```

## boards/rakwireless/rzi_rak3362/board.yml
```yaml
# SPDX-FileCopyrightText: Copyright (c) 2026 RAKwireless
# SPDX-License-Identifier: Apache-2.0
board:
  name: rzi_rak3362
  full_name: RZI RAK3362
  vendor: rakwireless
  socs:
  - name: nrf54l15
```

## boards/rakwireless/rzi_rak3362/rzi_rak3362_nrf54l15_cpuapp_defconfig
```kconfig
# SPDX-License-Identifier: Apache-2.0

# Enable Clocks
CONFIG_CLOCK_CONTROL=y

# Power Management
CONFIG_PM_DEVICE=y
CONFIG_NRFX_POWER=y

# GPIO
CONFIG_GPIO=y

# Console is uart20; the SoC has no USB device controller
CONFIG_SERIAL=y
CONFIG_CONSOLE=y
CONFIG_UART_CONSOLE=y

# Memory Protection
CONFIG_ARM_MPU=y
CONFIG_HW_STACK_PROTECTION=y
CONFIG_NULL_POINTER_EXCEPTION_DETECTION_NONE=y

# Cache
CONFIG_CACHE_MANAGEMENT=y
CONFIG_EXTERNAL_CACHE=y

# GRTC system timer
CONFIG_NRF_GRTC_START_SYSCOUNTER=y

# Regulator
CONFIG_REGULATOR=y
CONFIG_REGULATOR_FIXED_INIT_PRIORITY=45

CONFIG_PINCTRL_KEEP_SLEEP_STATE=y
```

## boards/rakwireless/rzi_rak3362/rzi_rak3362_nrf54l15_cpuflpr_defconfig
```kconfig
# SPDX-License-Identifier: Apache-2.0

# GPIO
CONFIG_GPIO=y

# Execute from SRAM
CONFIG_XIP=n
```

## boards/rakwireless/rzi_rak3362/rzi_rak3362_nrf54l15_cpuflpr_xip_defconfig
```kconfig
# SPDX-License-Identifier: Apache-2.0

# GPIO
CONFIG_GPIO=y

# Execute from RRAM
CONFIG_XIP=y
```

## boards/rakwireless/rzi_rak3372/Kconfig.sysbuild
```kconfig
# SPDX-FileCopyrightText: Copyright (c) 2026 RAKwireless
# SPDX-License-Identifier: Apache-2.0

choice MCUBOOT_MODE
	default MCUBOOT_MODE_SINGLE_APP
endchoice
```

## boards/rakwireless/rzi_rak3372/board.yml
```yaml
# SPDX-FileCopyrightText: Copyright (c) 2026 RAKwireless
# SPDX-License-Identifier: Apache-2.0
board:
  name: rzi_rak3372
  full_name: RZI RAK3372
  vendor: rakwireless
  socs:
  - name: stm32wle5xx
```

## boards/rakwireless/rzi_rak3372_f/Kconfig.rzi_rak3372_f
```kconfig
# SPDX-FileCopyrightText: Copyright (c) 2026 RAKwireless
# SPDX-License-Identifier: Apache-2.0

config BOARD_RZI_RAK3372_F
	select SOC_STM32WLE5XX
```

## boards/rakwireless/rzi_rak3372_f/board.yml
```yaml
# SPDX-FileCopyrightText: Copyright (c) 2026 RAKwireless
# SPDX-License-Identifier: Apache-2.0
board:
  name: rzi_rak3372_f
  full_name: RZI RAK3372-F
  vendor: rakwireless
  socs:
  - name: stm32wle5xx
```

## boards/rakwireless/rzi_rak4631/Kconfig.defconfig
```kconfig
# SPDX-FileCopyrightText: Copyright (c) 2026 RAKwireless
# SPDX-License-Identifier: Apache-2.0

if BOARD_RZI_RAK4631

config BOARD_EARLY_INIT_HOOK
	default y

endif # BOARD_RZI_RAK4631
```

## boards/rakwireless/rzi_rak4631/Kconfig.rzi_rak4631
```kconfig
# SPDX-FileCopyrightText: Copyright (c) 2026 RAKwireless
# SPDX-License-Identifier: Apache-2.0

config BOARD_RZI_RAK4631
	select SOC_NRF52840_QIAA
```

## boards/rakwireless/rzi_rak4631/board.yml
```yaml
# SPDX-FileCopyrightText: Copyright (c) 2026 RAKwireless
# SPDX-License-Identifier: Apache-2.0
board:
  name: rzi_rak4631
  full_name: RZI RAK4631
  vendor: rakwireless
  socs:
  - name: nrf52840
```

## boards/rzi/rzi_rak3372/Kconfig.rzi_rak3372
```kconfig
# SPDX-License-Identifier: Apache-2.0

config BOARD_RZI_RAK3372
	select SOC_STM32WLE5XX
```
